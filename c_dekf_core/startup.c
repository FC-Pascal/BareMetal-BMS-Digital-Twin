/* startup.c : bare-metal startup for STM32F401RE, Arm Compiler 6 (armclang + armlink)
 * Requires: stm32f401re.sct as the scatter file, and --datacompressor=off
 * in Options for Target > Linker > Misc controls.
 */
#include <stdint.h>

#define SCB_CPACR (*((volatile uint32_t *)0xE000ED88))

extern int main(void);

/* Generated by armlink from stm32f401re.sct */
extern uint32_t Image$$ARM_LIB_STACK$$ZI$$Limit[];  /* top of the reserved stack  */
extern uint32_t Load$$RW_IRAM1$$Base[];             /* .data initial values, flash */
extern uint32_t Image$$RW_IRAM1$$RW$$Base[];        /* .data, SRAM                 */
extern uint32_t Image$$RW_IRAM1$$RW$$Limit[];
extern uint32_t Image$$RW_IRAM1$$ZI$$Base[];        /* .bss, SRAM                  */
extern uint32_t Image$$RW_IRAM1$$ZI$$Limit[];

void Reset_Handler(void);
void Default_Handler(void) { while (1); }

typedef void (*vector_t)(void);

/* The elements are const, so the table is RO data and +First places it at 0x08000000 */
__attribute__((section("RESET"), used))
const vector_t __Vectors[] = {
    (vector_t)Image$$ARM_LIB_STACK$$ZI$$Limit,  /* initial MSP */
    Reset_Handler,
    Default_Handler,                            /* NMI         */
    Default_Handler,                            /* HardFault   */
};

void Reset_Handler(void)
{
    const uint32_t    *src = Load$$RW_IRAM1$$Base;
    volatile uint32_t *dst = Image$$RW_IRAM1$$RW$$Base;  /* volatile: keeps these loops off memcpy/memset */

    while (dst < Image$$RW_IRAM1$$RW$$Limit) {           /* copy .data from flash */
        *dst++ = *src++;
    }

    dst = Image$$RW_IRAM1$$ZI$$Base;
    while (dst < Image$$RW_IRAM1$$ZI$$Limit) {           /* zero .bss */
        *dst++ = 0u;
    }

    SCB_CPACR |= (0xFu << 20);                           /* CP10, CP11 full access */
    __asm volatile ("dsb\n\tisb" ::: "memory");

    main();
    while (1);
}